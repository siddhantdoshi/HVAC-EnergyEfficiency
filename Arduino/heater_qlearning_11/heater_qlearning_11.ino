#define HEATER_A1_PIN 7 // Driver Board IN1
#define HEATER_B1_PIN 8 // Driver Board IN2
#define HEATER_PWM 5 // Driver Board PWM
#define EN_PIN A0 // Driver Board EN
#define CS_PIN A1 // Driver Board CS
#define THERMISTOR_PIN A2 // Thermistor (temperature sensor)

const int delta_T = 5;
const float resistance = 3.8;
float current = 0.0;
const float max_voltage = 9.66;

//const unsigned char q_actions[749] = {128, 127, 241, 196, 230, 228, 249, 253, 245, 253, 218, 241, 230,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 0, 0};
//const unsigned char q_actions[74] = {247, 236, 237, 239, 237, 227, 248, 171, 187, 251, 249, 239, 214,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 0, 0};

// action matrix for training simulation 8
//const unsigned char q_actions[174] = {0, 245, 0, 0, 239, 0, 0, 187, 0, 0, 245, 0, 0,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 0, 1};

// action matrix for training simulation 9
// const unsigned char q_actions[171] = {0, 246, 0, 0, 246, 0, 0, 185, 0, 0, 253, 0, 0,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 0, 1};

// action matrix for training simulation 11
//const unsigned char q_actions[160] = {0, 241, 0, 0, 241, 252, 0, 241, 235, 0, 247, 247, 0,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 161, 0};

// action matrix for training simulation 11_rewward
//const unsigned char q_actions[162] = {0, 254, 251, 0, 254, 223, 0, 223, 228, 0, 236, 236, 0,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 1, 1};

// action matrix for training simulation 11_rewward_1
//const unsigned char q_actions[161] = {33, 196, 251, 0, 196, 225, 0, 204, 240, 0, 121, 248, 0,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 1, 1};

// action matrix for training simulation 11_20200820-093404
//const unsigned char q_actions[153] = {0, 254, 0, 0, 252, 248, 0, 238, 254, 0, 189, 189, 0,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 0, 219};
// action matrix for training simulation 11_20200820-093404
//const unsigned char q_actions[174] = {0, 254, 234, 0, 227, 246, 0, 252, 252, 0, 227, 250, 0,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 1, 1};

//action matrix for training simulation final_actions_11_2_20200820-212924
//const unsigned char q_actions[159] = {0, 216, 210, 0, 166, 246, 0, 126, 214, 0, 189, 246, 0,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 0, 1};

//action matrix for training simulation final_actions_11_2_20200820-231559
//const unsigned char q_actions[151] = {0, 128, 176, 0, 234, 250, 0, 243, 246, 0, 230, 230, 0,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 49, 0};

//action matrix for training simulation final_actions_11_2_20200821-001751
//const unsigned char q_actions[150] = {0, 250, 241, 0, 232, 246, 0, 105, 240, 0, 244, 236, 0,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 110, 31};

//action matrix for training simulation final_actions_11_2_20200821-004658
//const unsigned char q_actions[150] = {0, 238, 195, 0, 157, 250, 0, 10, 254, 0, 118, 250, 0,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 132, 1};

//action matrix for training simulation final_actions_11_3_20200821-110855
//const unsigned char q_actions[153] = {0, 241, 0, 0, 241, 248, 0, 243, 246, 0, 239, 239, 0,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 23, 9};

//action matrix for training simulation final_actions_11_3_20200821-115609
//const unsigned char q_actions[151] = {0, 205, 0, 0, 242, 252, 0, 8, 250, 0, 143, 240, 0,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 28, 0};

//final_actions_11_3_20200821-143348
//const unsigned char q_actions[150] = {0, 211, 248, 0, 237, 248, 0, 212, 248, 0, 220, 248, 0,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 159, 85};

//final_actions_11_3_20200821-202146
const unsigned char q_actions[151] = {0, 230, 0, 0, 210, 233, 0, 215, 175, 0, 254, 251, 0,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 56, 0};

const int num_sensor_readings = 100;
int temp_val[num_sensor_readings];

float set_point;
int state = 0;

float output_power = 0.0;
int pwm_output = 0;

float prev_temp = 0.0;

int count = 0;

int action_table_size = 0;


float temp_sort_clean()
{
  int temp = 0;
  for (int i = 0; i < (num_sensor_readings - 1); i++)
  {
    for (int j = 0; j < (num_sensor_readings - 1 - i); j++)
    {
      if (temp_val[j] < temp_val[j + 1])
      {
        temp = temp_val[j];
        temp_val[j] = temp_val[j + 1];
        temp_val[j + 1] = temp;
      }
    }
  }

    return temp_val[49];
}

float get_temp()
{
  float sensor_average = 0;

  for (int i = 0; i < num_sensor_readings; i++)
  {
    int sensor_val = analogRead(THERMISTOR_PIN);
    temp_val[i] = sensor_val;
    delay(1000 / num_sensor_readings);
  }
      
  sensor_average = temp_sort_clean();
  
  float voltage = sensor_average * 5.0 / 1024.0;
  float resistance = 10000.0 * (voltage / (5.0 - voltage));
  float temp_reciprocal = 1.0 / 295.15 + log(resistance / 10000.0) / 3950.0;
  float temperature = (1.0 / temp_reciprocal) - 273.15;

  return temperature;
}

void setup()
{
  pinMode(HEATER_A1_PIN, OUTPUT);
  pinMode(HEATER_B1_PIN, OUTPUT);
  pinMode(HEATER_PWM, OUTPUT);
  pinMode(EN_PIN, OUTPUT);
  pinMode(CS_PIN, INPUT);

  digitalWrite(EN_PIN, HIGH);
  digitalWrite(HEATER_A1_PIN, LOW);
  digitalWrite(HEATER_B1_PIN, HIGH);
  
  analogWrite(HEATER_PWM, 0); // Sets heater to off

  action_table_size = sizeof(q_actions)/sizeof(q_actions[0]);
  
  Serial.begin(9600);
  Serial.println("Timestamp, Temperature (ºC), Setpoint, Error, Delta_T, State, PWM output, Current, PWM / Current");
  // put your setup code here, to run once:

}

int getstate(float temp, float delta_temp) {
  temp = round(temp * 10.0) / 10.0;
  delta_temp = round(delta_temp * 10.0) / 10.0;

  if ( delta_temp > 0.1 ) {
    delta_temp = 0.1;
  } else if (delta_temp < -0.1) {
    delta_temp = -0.1;
  }
  
  
  int conjugate = 1000 * temp + 10 * delta_temp + 5001;
  int index = (floor(conjugate / 100.0) * 3) + (conjugate % 100);

  return index;
}

void loop()
{
  // put your main code here, to run repeatedly:
  float temperature = get_temp();

  float velocity = temperature - prev_temp ;

  if (count == 5)
  {
    set_point = temperature + delta_T - 0.2;
    Serial.println(set_point);
    count ++;
  }

  state = getstate(temperature - set_point - 0.2, velocity);
  pwm_output = 0;
  
  if (state < action_table_size) {
    pwm_output = q_actions[state];  
  }


  analogWrite(HEATER_PWM, pwm_output);  
  
  
  current = analogRead(CS_PIN) * 5.0 / (1024 * 0.13) - 0.189;

  Serial.print(temperature);

  Serial.print(", ");
  Serial.print(set_point + 0.2);

  Serial.print(", ");
  Serial.print(temperature - set_point - 0.2);
  
  Serial.print(", ");
  Serial.print(velocity);
  
  Serial.print(", ");
  Serial.print(state);

  Serial.print(", ");
  Serial.print(pwm_output);
  
  Serial.print(", ");
  Serial.print(current);

  Serial.print(", ");
  Serial.println(pwm_output / current);

  prev_temp = temperature ;
  count ++;
}
